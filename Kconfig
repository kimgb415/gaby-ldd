## Kconfig
```kconfig
menuconfig LDD
    bool "Linux Device Driver by Gaby Kim"
    help 
        This is the menu for drivers related to 
        Linux Device Driver 3rd edition, compatible with
        linux 6.7.0

source "drivers/gakim/scull/Kconfig"
```

## scull/Kconfig
```kconfig
config SCULL
    tristate "Scull driver by Gaby, Kim"
    depends on LDD
    help
        This is scull device driver based on Linux Device Drvier, 3rd edition,
        compatible with linux 6.7.0, Authored by Gaby, Kim.

config DEBUG_SCULL
    bool "Enable debugging features of scull driver by Gaby, Kim"
    depends on DEBUG_KERNEL && SCULL
    help
        To enable debugging features of this driver, choose y here.
```
